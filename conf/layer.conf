## conf/layer.conf
```bitbake
# conf and classes directories: append to BBPATH
BBPATH .= ":${LAYERDIR}"

# recipes directory: add to BBFILES
BBFILES += " \
    ${LAYERDIR}/recipes*/*.bb \
    ${LAYERDIR}/recipes*/*/*.bb \
    ${LAYERDIR}/recipes*/*/*.bbappend \
    ${LAYERDIR}/recipes*/*/*.bb \
    ${LAYERDIR}/recipes*/*/*.bbappend \
    "

BBFILE_COLLECTIONS += "argo-linux-layer"
BBFILE_PATTERN_argo-linux-layer := "^${LAYERDIR}/"
BBFILE_PRIORITY_argo-linux-layer = "12"

# This should only be incremented on significant changes that will
# cause compatibility issues with other layers
LAYERVERSION_argo-linux-layer = "1"

LAYERSERIES_COMPAT_argo-linux-layer = "nanbield"

LAYERDEPENDS_argo-linux-layer = " \
    core \
    openembedded-layer \
    networking-layer \
    filesystems-layer \
    virtualization-layer \
"

USER_CLASSES:append = " xtf-argo-cfg"
```
